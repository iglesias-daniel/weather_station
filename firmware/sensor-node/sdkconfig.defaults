## firmware/sensor-node/sdkconfig.defaults
```kconfig
# Target
CONFIG_IDF_TARGET="esp32s3"

# Power management, required for ULP + deep-sleep duty cycling
CONFIG_PM_ENABLE=y
CONFIG_FREERTOS_USE_TICKLESS_IDLE=y

# ULP RISC-V co-processor
CONFIG_ULP_COPROC_ENABLED=y
CONFIG_ULP_COPROC_TYPE_RISCV=y
CONFIG_ULP_COPROC_RESERVE_MEM=4096

# Flash size
CONFIG_ESPTOOLPY_FLASHSIZE_4MB=y
```
